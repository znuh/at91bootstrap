## contrib/board/gnublin/sama5d4_gnublin2/sama5d4_gnublin2_defconfig
```kconfig
CONFIG_SAMA5D4_GNUBLIN2=y
CONFIG_CPU_CLK_600MHZ=y
CONFIG_SDCARD=y
CONFIG_DEBUG=y
CONFIG_SCLK=y
# CONFIG_ENTER_NWD is not set
CONFIG_PM_EXTERNAL_DEVICES=y
CONFIG_MAC0_PHY=y
CONFIG_ACT8865=y
CONFIG_PMIC_ON_TWI3=y
# CONFIG_LOAD_EEPROM is not set
```
